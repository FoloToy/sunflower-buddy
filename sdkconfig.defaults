## sdkconfig.defaults
```kconfig
# Sunflower Buddy V1.4 reference baseline: ESP32-S3, 16 MB flash and octal PSRAM.
CONFIG_IDF_TARGET="esp32s3"
CONFIG_ESPTOOLPY_FLASHMODE_QIO=y
CONFIG_ESPTOOLPY_FLASHSIZE_16MB=y
CONFIG_PARTITION_TABLE_CUSTOM=y
CONFIG_PARTITION_TABLE_CUSTOM_FILENAME="partitions.csv"
CONFIG_PARTITION_TABLE_FILENAME="partitions.csv"

CONFIG_SPIRAM=y
CONFIG_SPIRAM_MODE_OCT=y
CONFIG_SPIRAM_SPEED_80M=y
CONFIG_SPIRAM_MEMTEST=y
CONFIG_SPIRAM_MALLOC_RESERVE_INTERNAL=32768

CONFIG_FREERTOS_HZ=1000
CONFIG_ESP_MAIN_TASK_STACK_SIZE=5120
CONFIG_ESP_CONSOLE_SECONDARY_USB_SERIAL_JTAG=y
CONFIG_ESP_COREDUMP_ENABLE_TO_FLASH=y

# BLE-only BLUFI provisioning with encrypted credential transport.
CONFIG_BT_ENABLED=y
CONFIG_BT_BLUEDROID_ENABLED=y
CONFIG_BT_NIMBLE_ENABLED=n
CONFIG_BT_GATTC_ENABLE=n
CONFIG_BT_BLE_SMP_ENABLE=n
CONFIG_BT_BLE_BLUFI_ENABLE=y
CONFIG_BT_BLE_42_FEATURES_SUPPORTED=y
# CONFIG_BT_BLE_50_FEATURES_SUPPORTED is not set
CONFIG_MBEDTLS_HARDWARE_MPI=n
CONFIG_MBEDTLS_DHM_C=y

# Required by folotoy-firmware-driver's AXP2101/GX8002 adapters.
CONFIG_I2C_COMMUNICATION_METHOD_BUILTIN_RW=y
CONFIG_SENSORLIB_ESP_IDF_NEW_API=y
CONFIG_XPOWERS_ESP_IDF_NEW_API=y
CONFIG_SENSOR_PMIC_SUPPORT=y
```
